## apps/examples/bdriver/Kconfig
```kconfig
config EXAMPLES_BDRIVER
	tristate "\"BOARD_DRIVER!\" example"
	default n
	---help---
		Enable the \"Hello, BOARD_DRIVER!\" example

if EXAMPLES_BDRIVER

config EXAMPLES_BDRIVER_PROGNAME
	string "BOARD_DRIVER"
	default "BOARD_DRIVER"
	---help---
		This is the name of the program that will be used when the NSH ELF
		program is installed.

config EXAMPLES_BDRIVER_PRIORITY
	int "Hello task priority"
	default 100

config EXAMPLES_BDRIVER_STACKSIZE
	int "BOARD_DRIVER stack size"
	default DEFAULT_TASK_STACKSIZE

endif
```

## apps/examples/blinky/Kconfig
```kconfig
config EXAMPLES_BLINKY
	tristate "\"Hello, BLINKY!\" example"
	default n
	---help---
		Enable the \"Hello, Blinky!\" example

if EXAMPLES_BLINKY

config EXAMPLES_BLINKY_PROGNAME
	string "blinky"
	default "blinky"
	---help---
		This is the name of the program that will be used when the NSH ELF
		program is installed.

config EXAMPLES_BLINKY_PRIORITY
	int "Hello task priority"
	default 100

config EXAMPLES_BLINKY_STACKSIZE
	int "Hello stack size"
	default DEFAULT_TASK_STACKSIZE

endif
```

## apps/examples/usbcdc/Kconfig
```kconfig
#
# For a description of the syntax of this configuration file,
# see the file kconfig-language.txt in the NuttX tools repository.
#

config EXAMPLES_USBCDC
	tristate "\"USB CDC!\" example"
	default n
	---help---
		Enable the \"Hello, USBCDC!\" example

if EXAMPLES_USBCDC

config EXAMPLES_USBCDC_PROGNAME
	string "USB_CDC"
	default "USB_CDC"
	---help---
		This is the name of the program that will be use when the NSH ELF
		program is installed.

config EXAMPLES_USBCDC_PRIORITY
	int "USBCDC task priority"
	default 100

config EXAMPLES_USBCDC_STACKSIZE
	int "USBCDC stack size"
	default 2048

endif
```
